## boards/shields/c0ba-trackball/Kconfig.defconfig
```kconfig
if SHIELD_C0BA_TRACKBALL
config ZMK_POINTING
    default y
config ZMK_KEYBOARD_NAME
	default "c0ba-trackball"
config USB_HID_POLL_INTERVAL_MS
	default 10
endif
```

## boards/shields/c0ba-trackball/Kconfig.shield
```kconfig
# No whitespace after the comma or in your part name!

config SHIELD_C0BA_TRACKBALL
    def_bool $(shields_list_contains,c0ba-trackball)
```
