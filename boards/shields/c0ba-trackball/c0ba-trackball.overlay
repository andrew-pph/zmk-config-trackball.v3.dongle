#include "c0ba-trackball.dtsi"
#include "c0ba-trackball-layouts.dtsi"

/*
 Complains about not having "input property in peripheral input splits, but also don't recognise <&trackball> if I assign one. Hmmm.
 Maybe try pretending there's one? Since I can't quite delete it;
 Or, move split input and listener stuffs into another .dtsi file.
*/

/ {
	chosen {
		zmk,kscan = &kscan0;
	};

	kscan0: kscan {
	        compatible = "zmk,kscan-gpio-direct";
        	wakeup-source;
        	input-gpios
            		= <&gpio0 8 (GPIO_ACTIVE_LOW | GPIO_PULL_UP)>
            		, <&gpio0 17 (GPIO_ACTIVE_LOW | GPIO_PULL_UP)>
            		, <&gpio0 20 (GPIO_ACTIVE_LOW | GPIO_PULL_UP)>
            		;
	};
};
